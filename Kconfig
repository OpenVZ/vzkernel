## Kconfig
```kconfig
#
# For a description of the syntax of this configuration file,
# see Documentation/kbuild/kconfig-language.txt.
#
mainmenu "Linux/$ARCH $KERNELVERSION Kernel Configuration"

config SRCARCH
	string
	option env="SRCARCH"

source "arch/$SRCARCH/Kconfig"

config RH_KABI_SIZE_ALIGN_CHECKS
	bool "Enables more stringent kabi checks in the macros"
	default y
	help
	  This option enables more stringent kabi checks. Those must be disabled
	  in case of a debug-build because they allow to change struct sizes.
```

## arch/powerpc/platforms/powernv/Kconfig
```kconfig
config PPC_POWERNV
	depends on PPC64 && PPC_BOOK3S
	bool "IBM PowerNV (Non-Virtualized) platform support"
	select PPC_NATIVE
	select PPC_XICS
	select PPC_ICP_NATIVE
	select PPC_P7_NAP
	select PPC_PCI_CHOICE if EMBEDDED
	select EPAPR_BOOT
	select PPC_INDIRECT_PIO
	select PPC_UDBG_16550
	select PPC_SCOM
	select ARCH_RANDOM
	select PPC_DOORBELL
	default y

config OPAL_PRD
	tristate 'OPAL PRD driver'
	depends on PPC_POWERNV
	help
	  This enables the opal-prd driver, a facility to run processor
	  recovery diagnostics on OpenPower machines
```

## drivers/cpuidle/Kconfig
```kconfig
menuconfig CPU_IDLE
	bool "CPU idle PM support"
	default y if ACPI || PPC_PSERIES
	select CPU_IDLE_GOV_LADDER if (!NO_HZ && !NO_HZ_IDLE)
	select CPU_IDLE_GOV_MENU if (NO_HZ || NO_HZ_IDLE)
	help
	  CPU idle is a generic framework for supporting software-controlled
	  idle processor power management.  It includes modular cross-platform
	  governors that can be swapped during runtime.

	  If you're using an ACPI-enabled platform, you should say Y here.

if CPU_IDLE

config CPU_IDLE_MULTIPLE_DRIVERS
        bool "Support multiple cpuidle drivers"
        default n
        help
         Allows the cpuidle framework to use different drivers for each CPU.
         This is useful if you have a system with different CPU latencies and
         states. If unsure say N.

config CPU_IDLE_GOV_LADDER
	bool "Ladder governor (for periodic timer tick)"
	default y

config CPU_IDLE_GOV_MENU
	bool "Menu governor (for tickless system)"
	default y

config CPU_IDLE_GOV_HALTPOLL
       bool "Haltpoll governor (for virtualized systems)"
       depends on X86 && KVM_GUEST
       help
         This governor implements haltpoll idle state selection, to be
         used in conjunction with the haltpoll cpuidle driver, allowing
         for polling for a certain amount of time before entering idle
         state.

         Some virtualized workloads benefit from using it.

config CPU_IDLE_CALXEDA
	bool "CPU Idle Driver for Calxeda processors"
	depends on ARCH_HIGHBANK
	help
	  Select this to enable cpuidle on Calxeda processors.

menu "POWERPC CPU Idle Drivers"
depends on PPC
source "drivers/cpuidle/Kconfig.powerpc"
endmenu

config HALTPOLL_CPUIDLE
       tristate "Halt poll cpuidle driver"
       depends on X86 && KVM_GUEST
       default y
       help
         This option enables halt poll cpuidle driver, which allows to poll
         before halting in the guest (more efficient than polling in the
         host via halt_poll_ns for some scenarios).

endif

config ARCH_NEEDS_CPU_IDLE_COUPLED
	def_bool n
```

## drivers/crypto/ccp/Kconfig
```kconfig
config CRYPTO_DEV_CCP_DD
	tristate "Cryptographic Coprocessor device driver"
	depends on CRYPTO_DEV_CCP
	default m
	select HW_RANDOM
	select DMA_ENGINE
	select DMADEVICES
	select CRYPTO_SHA1
	select CRYPTO_SHA256
	help
	  Provides the interface to use the AMD Cryptographic Coprocessor
	  which can be used to offload encryption operations such as SHA,
	  AES and more. If you choose 'M' here, this module will be called
	  ccp.
```

## drivers/infiniband/hw/qedr/Kconfig
```kconfig
config INFINIBAND_QEDR
	tristate "QLogic RoCE driver"
	depends on 64BIT && QEDE
	depends on PCI
	select QED_LL2
	select QED_OOO
	select QED_RDMA
	default n
	---help---
	  This driver provides low-level InfiniBand over Ethernet
```

## drivers/input/rmi4/Kconfig
```kconfig
#
# RMI4 configuration
#
config RMI4_CORE
	tristate "Synaptics RMI4 bus support"
	help
	  Say Y here if you want to support the Synaptics RMI4 bus.  This is
	  required for all RMI4 device support.

	  If unsure, say Y.

if RMI4_CORE

config RMI4_SMB
	tristate "RMI4 SMB Support"
	depends on I2C
	help
	  Say Y here if you want to support RMI4 devices connected to an SMB
	  bus.

	  If unsure, say N.

	  To compile this driver as a module, choose M here: the module will be
	  called rmi_smbus.

config RMI4_F03
        bool "RMI4 Function 03 (PS2 Guest)"
	depends on RMI4_CORE
        help
          Say Y here if you want to add support for RMI4 function 03.

	  Function 03 provides PS2 guest support for RMI4 devices. This
	  includes support for TrackPoints on TouchPads.

config RMI4_F03_SERIO
	tristate
	depends on RMI4_CORE
	depends on RMI4_F03
	default RMI4_CORE
	select SERIO

config RMI4_2D_SENSOR
	bool

config RMI4_F11
	bool "RMI4 Function 11 (2D pointing)"
	select RMI4_2D_SENSOR
	help
	  Say Y here if you want to add support for RMI4 function 11.

	  Function 11 provides 2D multifinger pointing for touchscreens and
	  touchpads. For sensors that support relative pointing, F11 also
	  provides mouse input.

config RMI4_F12
	bool "RMI4 Function 12 (2D pointing)"
	select RMI4_2D_SENSOR
	help
	  Say Y here if you want to add support for RMI4 function 12.

	  Function 12 provides 2D multifinger pointing for touchscreens and
	  touchpads. For sensors that support relative pointing, F12 also
	  provides mouse input.

config RMI4_F30
	bool "RMI4 Function 30 (GPIO LED)"
	help
	  Say Y here if you want to add support for RMI4 function 30.

	  Function 30 provides GPIO and LED support for RMI4 devices. This
	  includes support for buttons on TouchPads and ClickPads.

endif # RMI_CORE
```

## drivers/mailbox/Kconfig
```kconfig
menuconfig MAILBOX
	bool "Mailbox Hardware Support"
	help
	  Mailbox is a framework to control hardware communication between
	  on-chip processors through queued messages and interrupt driven
	  signals. Say Y if your platform supports hardware mailboxes.

if MAILBOX
config PL320_MBOX
	bool "ARM PL320 Mailbox"
	depends on ARM_AMBA
	help
	  An implementation of the ARM PL320 Interprocessor Communication
	  Mailbox (IPCM), tailored for the Calxeda Highbank. It is used to
	  send short messages between Highbank's A9 cores and the EnergyCore
	  Management Engine, primarily for cpufreq. Say Y here if you want
	  to use the PL320 IPCM support.

config PCC
	bool "Platform Communication Channel Driver"
	depends on ACPI
	help
	  ACPI 5.0+ spec defines a generic mode of communication
	  between the OS and a platform such as the BMC. This medium
	  (PCC) is typically used by CPPC (ACPI CPU Performance management),
	  RAS (ACPI reliability protocol) and MPST (ACPI Memory power
	  states). Select this driver if your platform implements the
	  PCC clients mentioned above.

endif
```

## drivers/net/ethernet/cavium/Kconfig
```kconfig
#
# Cavium ethernet device configuration
#

config NET_VENDOR_CAVIUM
	tristate "Cavium ethernet drivers"
	depends on PCI
	default y
	---help---
	  Select this option if you want enable Cavium network support.

	  If you have a Cavium SoC or network adapter, say Y.

if NET_VENDOR_CAVIUM

config LIQUIDIO
	tristate "Cavium LiquidIO support"
	depends on 64BIT
	depends on MAY_USE_DEVLINK
	select PTP_1588_CLOCK
	select FW_LOADER
	select LIBCRC32C
	---help---
	  This driver supports Cavium LiquidIO Intelligent Server Adapters
	  based on CN66XX, CN68XX and CN23XX chips.

	  To compile this driver as a module, choose M here: the module
	  will be called liquidio.  This is recommended.

config LIQUIDIO_VF
	tristate "Cavium LiquidIO VF support"
	depends on 64BIT && PCI_MSI
	select PTP_1588_CLOCK
	---help---
	  This driver supports Cavium LiquidIO Intelligent Server Adapter
	  based on CN23XX chips.

	  To compile this driver as a module, choose M here: The module
	  will be called liquidio_vf. MSI-X interrupt support is required
	  for this driver to work correctly

endif # NET_VENDOR_CAVIUM
```

## drivers/pinctrl/intel/Kconfig
```kconfig
#
# Intel pin control drivers
#

config PINCTRL_BAYTRAIL
	bool "Intel Baytrail GPIO pin control"
	depends on GPIOLIB && ACPI
	select IRQ_DOMAIN
	help
	  driver for memory mapped GPIO functionality on Intel Baytrail
	  platforms. Supports 3 banks with 102, 28 and 44 gpios.
	  Most pins are usually muxed to some other functionality by firmware,
	  so only a small amount is available for gpio use.

	  Requires ACPI device enumeration code to set up a platform device.

config PINCTRL_INTEL
	tristate
	select PINMUX
	select PINCONF
	select GENERIC_PINCONF
	select GPIOLIB
	select GPIOLIB_IRQCHIP

config PINCTRL_CANNONLAKE
	tristate "Intel Cannon Lake PCH pinctrl and GPIO driver"
	depends on ACPI
	select PINCTRL_INTEL
	help
	  This pinctrl driver provides an interface that allows configuring
	  of Intel Cannon Lake PCH pins and using them as GPIOs.

config PINCTRL_DENVERTON
	tristate "Intel Denverton pinctrl and GPIO driver"
	depends on ACPI
	select PINCTRL_INTEL
	help
	  This pinctrl driver provides an interface that allows configuring
	  of Intel Denverton SoC pins and using them as GPIOs.

config PINCTRL_GEMINILAKE
	tristate "Intel Gemini Lake SoC pinctrl and GPIO driver"
	depends on ACPI
	select PINCTRL_INTEL
	help
	  This pinctrl driver provides an interface that allows configuring
	  of Intel Gemini Lake SoC pins and using them as GPIOs.

config PINCTRL_LEWISBURG
	tristate "Intel Lewisburg pinctrl and GPIO driver"
	depends on ACPI
	select PINCTRL_INTEL
	help
	  This pinctrl driver provides an interface that allows configuring
	  of Intel Lewisburg pins and using them as GPIOs.

config PINCTRL_SUNRISEPOINT
	tristate "Intel Sunrisepoint pinctrl and GPIO driver"
	depends on ACPI
	select PINCTRL_INTEL
	help
	  Sunrisepoint is the PCH of Intel Skylake. This pinctrl driver
	  provides an interface that allows configuring of PCH pins and
	  using them as GPIOs.
```

## drivers/target/mhvtl/Kconfig
```kconfig
config MHVTL
	tristate "A Virtual Tape module"
	help
	  Say Y here to enable the Virtual Tape module.
	  The vtl is basically a stripped down scsi_debug kernel module + a
	  char dev 'back end' to pass the SCSI commands thru to user space
	  daemons. It is the user space daemons responsibility to respond and
	  process the SCSI commands.
```

## fs/fuse/Kconfig
```kconfig
config FUSE_FS
	tristate "FUSE (Filesystem in Userspace) support"
	help
	  With FUSE it is possible to implement a fully functional filesystem
	  in a userspace program.

	  There's also a companion library: libfuse2.  This library is available
	  from the FUSE homepage:
	  <http://fuse.sourceforge.net/>
	  although chances are your distribution already has that library
	  installed if you've installed the "fuse" package itself.

	  See <file:Documentation/filesystems/fuse.txt> for more information.
	  See <file:Documentation/Changes> for needed library/utility version.

	  If you want to develop a userspace FS, or if you want to use
	  a filesystem based on FUSE, answer Y or M.

config CUSE
	tristate "Character device in Userspace support"
	depends on FUSE_FS
	help
	  This FUSE extension allows character devices to be
	  implemented in userspace.

	  If you want to develop or use a userspace character device
	  based on CUSE, answer Y or M.

config FUSE_KIO_NOOP
	tristate "Enable kdirect noop io engine"
	depends on FUSE_FS
	default n
	help
	  This FUSE extension allows to handle io requests directly inside kernel

	  This is for kdirect io feature debugging only, answer Y or M.

config FUSE_KIO_NULLIO
	tristate "Enable kdirect null io io engine"
	depends on FUSE_FS
	default n
	help
	  This FUSE extension allows to handle io requests directly inside kernel

config FUSE_KIO_PCS
	tristate "Enable kdirect PCS io engine"
	depends on FUSE_FS
	help
	  This FUSE extension allows to forward io requests directly to PCS

config FUSE_KIO_DEBUG
	bool "Disable optimization for fuse kdirect PCS"
	depends on DEBUG_KERNEL && FUSE_FS
	help
	  Say Y if you want to disable optimization for fuse and fuse_kio_pcs modules.
```

## fs/kernfs/Kconfig
```kconfig
#
# KERNFS should be selected by its users
#

config KERNFS
	bool "KERNFS"
	default n
```

## kernel/Kconfig.openvz
```kconfig
# kernel/Kconfig.openvz
#
# Copyright (c) 2005-2008 SWsoft
# Copyright (c) 2009-2015 Parallels IP Holdings GmbH
# Copyright (c) 2017-2021 Virtuozzo International GmbH. All rights reserved.
#

menu "OpenVZ"

config VE
	bool "Virtual Environment support"
	default y
	select NAMESPACES
	select PID_NS
	select IPC_NS
	select UTS_NS
	select NET_NS
	select USER_NS
	select CGROUPS
	select CGROUP_DEVICE
	select CGROUP_FREEZER
	help
	  This option adds support of virtual Linux running on the original box
	  with fully supported virtual network driver, tty subsystem and
	  configurable access for hardware and other resources.

config VZ_DEV
	tristate "VE device"
	default m
	help
	  This option adds support of vzdev device, which is used by
	  user-space applications to control Virtual Environments.

endmenu
```

## kernel/bc/Kconfig
```kconfig
#
# User resources part (UBC)
#
# Copyright (c) 2005-2008 SWsoft
# Copyright (c) 2009-2015 Parallels IP Holdings GmbH
# Copyright (c) 2017-2019 Virtuozzo International GmbH. All rights reserved.
#

menu "User resources"

config BEANCOUNTERS
	bool "Enable user resource accounting"
	default y
	select CGROUPS
	select MEMCG
	select MEMCG_KMEM
	select MEMCG_SWAP if SWAP
	select MEMCG_SWAP_ENABLED if SWAP
	help 
          This patch provides accounting and allows to configure
          limits for user's consumption of exhaustible system resources.
          The most important resource controlled by this patch is unswappable 
          memory (either mlock'ed or used by internal kernel structures and 
          buffers). The main goal of this patch is to protect processes
          from running short of important resources because of an accidental
          misbehavior of processes or malicious activity aiming to ``kill'' 
          the system. It's worth to mention that resource limits configured 
          by setrlimit(2) do not give an acceptable level of protection 
          because they cover only small fraction of resources and work on a 
          per-process basis.  Per-process accounting doesn't prevent malicious
          users from spawning a lot of resource-consuming processes.

config BC_IO_ACCOUNTING
	bool "Account file I/O"
	default y
	depends on BEANCOUNTERS
	help
	  This option allows seeing I/O activity caused by tasks from each UB

config BC_IO_PRIORITY
	bool "Disk I/O priority"
	default y
	depends on BEANCOUNTERS
	select BLK_CGROUP
	help
	  This option add compat-layer on top of the blkio-cgroup for groupping
	  and prioritizing disk access.

config BC_PROC
	bool "Report resource usage in /proc"
	default y
	depends on BEANCOUNTERS
	help
          Allows a system administrator to inspect resource accounts and limits.

endmenu
```

## sound/soc/Kconfig
```kconfig
#
# SoC audio configuration
#

menuconfig SND_SOC
	tristate "ALSA for SoC audio support"
	select SND_PCM
	select AC97_BUS if SND_SOC_AC97_BUS
	select SND_JACK
	select REGMAP_I2C if I2C
	select REGMAP_SPI if SPI_MASTER
	---help---

	  If you want ASoC support, you should say Y here and also to the
	  specific driver for your SoC platform below.
	  
	  ASoC provides power efficient ALSA support for embedded battery powered
	  SoC based systems like PDA's, Phones and Personal Media Players.

	  This ASoC audio support can also be built as a module.  If so, the module
	  will be called snd-soc-core.

if SND_SOC

config SND_SOC_AC97_BUS
	bool

config SND_SOC_GENERIC_DMAENGINE_PCM
	bool
	select SND_DMAENGINE_PCM

config SND_SOC_COMPRESS
	bool
	select SND_COMPRESS_OFFLOAD

config SND_SOC_TOPOLOGY
	bool

# All the supported SoCs
source "sound/soc/intel/Kconfig"

# Supported codecs
source "sound/soc/codecs/Kconfig"

endif	# SND_SOC
```
